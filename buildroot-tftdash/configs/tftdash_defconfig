## buildroot-tftdash/configs/tftdash_defconfig
```kconfig
# TFT Dash — Buildroot defconfig for Raspberry Pi 3
#
# Based on raspberrypi3_defconfig with minimal additions for SDL2 display app.

# Architecture
BR2_arm=y
BR2_cortex_a53=y
BR2_ARM_FPU_NEON_VFPV4=y

# Toolchain — pre-built Bootlin cross-toolchain (much faster than building GCC)
BR2_TOOLCHAIN_EXTERNAL=y
BR2_TOOLCHAIN_EXTERNAL_BOOTLIN=y
BR2_TOOLCHAIN_EXTERNAL_BOOTLIN_ARMV7_EABIHF_GLIBC_STABLE=y

# Patches
BR2_GLOBAL_PATCH_DIR="board/raspberrypi/patches"

# System
BR2_TARGET_GENERIC_HOSTNAME="tftdash"
BR2_TARGET_GENERIC_ISSUE="TFT Dash"
BR2_TARGET_GENERIC_ROOT_PASSWD=""
BR2_SYSTEM_DHCP=""
BR2_ROOTFS_OVERLAY="$(BR2_EXTERNAL_TFTDASH_PATH)/overlay"
BR2_TARGET_GENERIC_GETTY_PORT="tty1"

# Kernel
BR2_LINUX_KERNEL=y
BR2_LINUX_KERNEL_CUSTOM_TARBALL=y
BR2_LINUX_KERNEL_CUSTOM_TARBALL_LOCATION="$(call github,raspberrypi,linux,rpi-6.1.y)/linux-rpi-6.1.y.tar.gz"
BR2_LINUX_KERNEL_DEFCONFIG="bcm2709"
BR2_LINUX_KERNEL_DTS_SUPPORT=y
BR2_LINUX_KERNEL_INTREE_DTS_NAME="broadcom/bcm2710-rpi-3-b broadcom/bcm2710-rpi-3-b-plus"
BR2_LINUX_KERNEL_NEEDS_HOST_OPENSSL=y

# Bootloader
BR2_PACKAGE_RPI_FIRMWARE=y
BR2_PACKAGE_RPI_FIRMWARE_BOOTCODE_BIN=y
BR2_PACKAGE_RPI_FIRMWARE_VARIANT_PI=y

# Filesystem
BR2_TARGET_ROOTFS_EXT2=y
BR2_TARGET_ROOTFS_EXT2_4=y
BR2_TARGET_ROOTFS_EXT2_SIZE="256M"
# BR2_TARGET_ROOTFS_TAR is not set

# SD card image
BR2_PACKAGE_HOST_GENIMAGE=y
BR2_PACKAGE_HOST_DOSFSTOOLS=y
BR2_PACKAGE_HOST_MTOOLS=y

# Packages — display
BR2_PACKAGE_SDL2=y
BR2_PACKAGE_SDL2_KMSDRM=y

# Packages — firmware flashing (for USB updates)
BR2_PACKAGE_AVRDUDE=y

# Packages — TFT Dash
BR2_PACKAGE_TFTDASH=y

# Packages — utilities
BR2_PACKAGE_BUSYBOX=y

# Post-image: generate SD card image
BR2_ROOTFS_POST_IMAGE_SCRIPT="$(BR2_EXTERNAL_TFTDASH_PATH)/board/post-image.sh"

# Minimal — disable things we don't need
# BR2_PACKAGE_IFUPDOWN_SCRIPTS is not set
# BR2_PACKAGE_URANDOM_SCRIPTS is not set
```

## buildroot-tftdash/package/tftdash/Config.in
```kconfig
config BR2_PACKAGE_TFTDASH
	bool "tftdash"
	help
	  TFT Dash motorcycle dashboard display application.
	  Installs a pre-built aarch64-linux-gnu binary and BMP assets.
```

## buildroot/package/tftdash/Config.in
```kconfig
config BR2_PACKAGE_TFTDASH
	bool "tftdash"
	depends on BR2_PACKAGE_SDL2
	help
	  TFT Dash motorcycle dashboard display application.
	  Installs a pre-built binary and BMP assets.
```
